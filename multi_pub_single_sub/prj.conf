## CMakeLists.txt
```
# Copyright (c) 2024 WATANABE Aoi
# SPDX-License-Identifier: Apache-2.0

cmake_minimum_required(VERSION 3.20.0)
find_package(Zephyr REQUIRED HINTS $ENV{ZEPHYR_BASE})

project(multi_pub_single_sub LANGUAGES C)

include_directories(src include)

FILE(GLOB app_sources ${CMAKE_CURRENT_SOURCE_DIR}/src/*.c)

target_sources(app PRIVATE ${app_sources})

FILE(GLOB event_sources src/events/*.c)
target_sources(app PRIVATE ${event_sources})
```

## prj.conf
```kconfig
CONFIG_LOG=y
CONFIG_ZBUS=y

# For QEMU
CONFIG_QEMU_ICOUNT=n
```

## src/thread_pub.c
```c
/*
 * Copyright (c) 2024 WATANABE Aoi
 *
 * SPDX-License-Identifier: Apache-2.0
 */

#include <zephyr/logging/log.h>
LOG_MODULE_REGISTER(pub, LOG_LEVEL_INF);

#include <zephyr/kernel.h>
#include <zephyr/zbus/zbus.h>

#include "events/int_event.h"

static void thread_pub(void *p1, void *p2, void *p3);

ZBUS_CHAN_DECLARE(int_chan);

static char name1[] = "pub1";
static char name2[] = "pub2";

static struct int_evt pub1 = {.data = 1};
static struct int_evt pub2 = {.data = 2};

K_THREAD_DEFINE(pub1_tid, 1024, thread_pub, name1, &pub1, NULL, 1, K_ESSENTIAL, 10);
K_THREAD_DEFINE(pub2_tid, 1024, thread_pub, name2, &pub2, NULL, 1, K_ESSENTIAL, 1000);

static void thread_pub(void *p1, void *p2, void *p3)
{
	const char *name = (char *)p1;
  const struct int_evt *evt = (struct int_evt *)p2;
  LOG_INF("Create thread [%s]", name);
	k_sleep(K_SECONDS(2));

	for (;;) {
		LOG_DBG("Spin [%s]", name);
		LOG_WRN("Publish [%s: %d]", name, evt->data);
    zbus_chan_pub(&int_chan,evt, K_FOREVER);
		k_sleep(K_SECONDS(2));
	}
}
```

## src/thread_sub.c
```c
/*
 * Copyright (c) 2024 WATANABE Aoi
 *
 * SPDX-License-Identifier: Apache-2.0
 */

#include <zephyr/logging/log.h>
LOG_MODULE_REGISTER(sub, LOG_LEVEL_INF);

#include <zephyr/kernel.h>
#include <zephyr/zbus/zbus.h>

#include "events/int_event.h"

static void thread_sub(void *p1, void *p2, void *p3);
static void zbus_lis_cb(const struct zbus_channel *chan);

ZBUS_CHAN_DECLARE(int_chan);

K_THREAD_DEFINE(sub_tid, 1024, thread_sub, NULL, NULL, NULL, 2, K_ESSENTIAL, 0);
ZBUS_LISTENER_DEFINE(sub_int_lis, zbus_lis_cb);

static void thread_sub(void *p1, void *p2, void *p3)
{
	ARG_UNUSED(p1);
	ARG_UNUSED(p2);
	ARG_UNUSED(p3);
	LOG_INF("Create thread [sub]");
	k_sleep(K_SECONDS(2));

	for (;;) {
		LOG_DBG("spin sub");
		k_sleep(K_SECONDS(2));
	}
}
static void zbus_lis_cb(const struct zbus_channel *chan)
{
	if (chan == &int_chan) {
		const struct int_evt *evt = zbus_chan_const_msg(chan);
		LOG_WRN("Subscribe [%d]", evt->data);
	}
}
```
